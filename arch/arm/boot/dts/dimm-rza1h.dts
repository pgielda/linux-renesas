/*
 * Device Tree Source for the emtrion DIMM-RZA1H board
 *
 * Copyright (C) 2014 emtrion GmbH <ferdinand.schwenk@emtrion.de>
 *
 * This file is licensed under the terms of the GNU General Public License
 * version 2.  This program is licensed "as is" without any warranty of any
 * kind, whether express or implied.
 *
 * This program is distributed in the hope that it will be useful,
 * but WITHOUT ANY WARRANTY; without even the implied warranty of
 * MERCHANTABILITY or FITNESS FOR A PARTICULAR PURPOSE.  See the
 * GNU General Public License for more details.
 */

/dts-v1/;
/include/ "skeleton.dtsi"

/ {
	model = "DIMM-RZA1H";
	compatible = "renesas,dimmrza1h";

	memory {
		device_type = "memory";
		reg = <0x08000000 0x08000000>;
	};
};
